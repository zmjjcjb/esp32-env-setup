## board_probe/sdkconfig.defaults
```kconfig
# 探测固件默认配置（通用）
# 不假设任何硬件参数：Flash 容量由探测程序读 JEDEC ID 得出，
# PSRAM 交给 sdkconfig.defaults.psram-oct 那个变体去验。
#
# 变体:
#   本文件          - 通用，Flash/PSRAM 都不预设
#   sdkconfig.defaults.psram-oct - 额外开 PSRAM 八线(OCT)，用于验证 S3 的 PSRAM 线数

CONFIG_SPIRAM=y
CONFIG_SPIRAM_MODE_QUAD=y
CONFIG_SPIRAM_TYPE_AUTO=y
CONFIG_SPIRAM_SPEED_80M=y
CONFIG_SPIRAM_SPEED=80
CONFIG_SPIRAM_CLK_IO=30
CONFIG_SPIRAM_CS_IO=26
CONFIG_SPIRAM_USE_MALLOC=y
CONFIG_SPIRAM_MEMTEST=y
CONFIG_IDF_TARGET="esp32"
CONFIG_SPIRAM=y
CONFIG_SPIRAM_MODE_QUAD=y
CONFIG_SPIRAM_TYPE_AUTO=y
CONFIG_SPIRAM_SPEED_80M=y
CONFIG_SPIRAM_SPEED=80
CONFIG_SPIRAM_CLK_IO=30
CONFIG_SPIRAM_CS_IO=26
CONFIG_SPIRAM_USE_MALLOC=y
CONFIG_SPIRAM_MEMTEST=y
```

## esp32_test/main/Kconfig.projbuild
```kconfig
menu "Board Test"

config TEST_LED_GPIO
    int "板载 LED 所在的 GPIO 号"
    default 2
    help
        绝大多数 ESP32 开发板的板载 LED 接在 GPIO2。
        如果灯不闪，把这个值改成你板子实际的引脚号。

endmenu
```
